

/* BMI270 sobre ESP32-S3 — TODO EN UN SOLO ARCHIVO
 * ============================================================================
 *
 * Driver del BMI270 (acelerómetro + giroscopio) autocontenido: no depende de
 * ningún componente externo, solo de ESP-IDF. Está pensado para copiarlo tal
 * cual a `main/main.c` de un proyecto nuevo y compilar.
 *
 * CÓMO USARLO
 *     idf.py create-project bmi270_test
 *     cp este_archivo.c  bmi270_test/main/main.c
 *     cd bmi270_test && idf.py set-target esp32s3 && idf.py build flash monitor
 *
 *     No hace falta tocar el CMakeLists.txt: `driver` y `esp_driver_i2c` ya
 *     vienen en el build por defecto de ESP-IDF v5.x.
 *
 * LO ÚNICO QUE HAY QUE AJUSTAR
 *     Los dos pines del bus I2C, en el bloque "CONFIGURACIÓN DE LA PLACA" que
 *     viene abajo. Los valores puestos son los de la placa IM-V2.
 *
 * QUÉ IMPRIME
 *     Una línea por muestra con los tres ejes del acelerómetro en m/s^2 y los
 *     tres del giroscopio en rad/s.
 *
 * PRUEBA DE CORDURA
 *     Con la placa quieta y horizontal: acc_z ≈ 9.81, acc_x y acc_y ≈ 0, y los
 *     tres del giroscopio ≈ 0.
 *
 * DIFERENCIAS CON EL DRIVER DEL PROYECTO
 *     1. Las funciones I2C (bus, slave, lectura y escritura de registros) están
 *        incluidas acá en vez de venir de un componente aparte.
 *     2. No lleva mutex de bus. El driver del proyecto sí, porque ahí varias
 *        tasks comparten el bus y una lectura de registro son DOS transacciones
 *        (escribir la dirección, después leer) que no se deben interrumpir.
 *        Acá hay una sola task, así que no hace falta.
 *     3. La conversión de dato crudo a unidades físicas es la ORIGINAL, con las
 *        constantes fijas. Ver la nota en bmi270_read().
 *
 * ESP-IDF v5.4.1
 * ============================================================================ */

/* MODIFICADO PARA LA TAREA 1 (TIC 3)
 * ============================================================================
 *
 * El driver (bus I2C y BMI270) está tal cual, sin tocar. Lo que cambió:
 *
 *   - Al final hay una sección nueva, "RED Y ADQUISICIÓN": WiFi, canal de
 *     control, canal de datos (TCP o UDP) y los modos secuencial y paralelo.
 *   - app_main ya no imprime muestras por el monitor serie: se conecta al
 *     servidor (web_server.py), recibe la configuración y envía las muestras.
 *   - Las muestras se leen de la FIFO del BMI270 (en ráfagas), no de a una:
 *     es lo que permite llegar a 1600 Hz. Ver fifo_take().
 *   - SAMPLE_PERIOD_MS y bmi270_read() ya no se usan. Quedan como referencia.
 *
 * Por eso dos cosas del encabezado original ya no valen para este proyecto:
 *
 *   - main/CMakeLists.txt SÍ declara componentes (esp_wifi, lwip, esp_timer...).
 *   - Se compila con ESP-IDF v6.1, no con v5.4.1.
 *
 * ANTES DE COMPILAR
 *     Copiar main/secrets.h.example a main/secrets.h y poner ahí el nombre y
 *     la clave del WiFi y la IP del computador que corre web_server.py.
 *
 * AJUSTES DEL PROYECTO (están en sdkconfig.defaults)
 *     CONFIG_ESP_MAIN_TASK_STACK_SIZE=16384   la carga del config_file del
 *                                             sensor ocupa ~8 KB de stack
 *     CONFIG_FREERTOS_HZ=1000                 tick de 1 ms; con el valor por
 *                                             defecto (100) no se puede
 *                                             muestrear a más de ~100 Hz
 * ============================================================================ */

#include <stdio.h>
#include <string.h>
#include <stdbool.h>
#include <stdint.h>
#include <errno.h>

#include "freertos/FreeRTOS.h" // IWYU pragma: keep
#include "freertos/task.h"
#include "freertos/event_groups.h"
#include "freertos/queue.h"
#include "freertos/semphr.h"
#include "driver/i2c_master.h"
#include "esp_err.h"
#include "esp_log.h"
#include "esp_wifi.h"
#include "nvs_flash.h"
#include "lwip/sockets.h"
#include "esp_netif.h"
#include "esp_timer.h"
#include "esp_event.h"

#include "secrets.h"   // WIFI_SSID, WIFI_PASS, SERVER_IP (no se sube a git)


/*****************************************************************/
/***************** CONFIGURACIÓN DE LA PLACA *********************/
/*****************************************************************/

/* Lo único que hay que cambiar para otra placa. */
#define I2C_MASTER_SCL_IO       GPIO_NUM_2      // reloj
#define I2C_MASTER_SDA_IO       GPIO_NUM_42     // datos
#define I2C_MASTER_FREQ_HZ      400000  // Tarea 1: era 100000. A 1600 Hz la FIFO entrega
                                        // ~11 KB/s, todo lo que cabe en un bus de 100 kHz.
                                        // El BMI270 admite 400 kHz (fast mode).

/* Cada cuánto se imprime una muestra. */
#define SAMPLE_PERIOD_MS        200


/*****************************************************************/
/******************** CONSTANTES DEL CHIP ************************/
/*****************************************************************/

/* Dirección I2C del BMI270. Es propiedad del integrado, no de la placa.
 * 0x68 con el pin SDO a GND; 0x69 si está a VDD. */
#define BMI270_SLAVE_ADDR 0x68

/* Output Data Rates que acepta este chip. */
#define BMI270_ODR_12_5     125
#define BMI270_ODR_25       25
#define BMI270_ODR_50       50
#define BMI270_ODR_100      100
#define BMI270_ODR_200      200
#define BMI270_ODR_400      400
#define BMI270_ODR_800      800
#define BMI270_ODR_1600     1600
#define BMI270_ODR_3200     3200

/* Una lectura del sensor, en unidades físicas. */
typedef struct {
    float acc_x_ms2;    // aceleración, m/s^2
    float acc_y_ms2;
    float acc_z_ms2;
    float gyr_x_rads;   // velocidad angular, rad/s
    float gyr_y_rads;
    float gyr_z_rads;
} bmi270_reading_t;

/*****************************************************************/
/************************ BUS I2C ********************************/
/*****************************************************************/

/* Estas cuatro funciones son las que en el proyecto viven en un componente
 * aparte (nebulaedge_i2c). Acá están incluidas para que el archivo se baste
 * solo. La velocidad por defecto del bus se guarda al inicializarlo, así que
 * un slave puede pedir freq_hz = 0 y heredarla. */

static uint32_t s_default_freq_hz = I2C_MASTER_FREQ_HZ;

static esp_err_t i2c_master_init(i2c_master_bus_handle_t *bus_handle) {
    i2c_master_bus_config_t bus_cfg = {
        .i2c_port = I2C_NUM_0,
        .sda_io_num = I2C_MASTER_SDA_IO,
        .scl_io_num = I2C_MASTER_SCL_IO,
        .clk_source = I2C_CLK_SRC_DEFAULT,
        .glitch_ignore_cnt = 7,
        .flags.enable_internal_pullup = true,
    };

    esp_err_t err = i2c_new_master_bus(&bus_cfg, bus_handle);
    vTaskDelay(pdMS_TO_TICKS(50));
    return err;
}

static esp_err_t i2c_slave_init(i2c_master_bus_handle_t *bus_handle,
                                i2c_master_dev_handle_t *device,
                                int slave_addr, uint32_t freq_hz) {
    if (bus_handle == NULL || *bus_handle == NULL || device == NULL) {
        return ESP_ERR_INVALID_ARG;
    }

    i2c_device_config_t dev_cfg = {
        .dev_addr_length = I2C_ADDR_BIT_LEN_7,
        .device_address = slave_addr,
        .scl_speed_hz = (freq_hz > 0) ? freq_hz : s_default_freq_hz,
    };

    esp_err_t err = i2c_master_bus_add_device(*bus_handle, &dev_cfg, device);
    vTaskDelay(pdMS_TO_TICKS(50));
    return err;
}

static esp_err_t i2c_slave_deinit(i2c_master_dev_handle_t *device) {
    if (device == NULL || *device == NULL) {
        return ESP_OK;
    }
    esp_err_t err = i2c_master_bus_rm_device(*device);
    if (err == ESP_OK) {
        *device = NULL;
    }
    return err;
}

/* Lee `size` bytes a partir del registro `data_address`.
 *
 * Son DOS transacciones: primero se escribe la dirección del registro, después
 * se leen los datos. En un sistema con varias tasks compartiendo el bus hay que
 * protegerlas con un mutex para que nadie se cuele entre las dos. */
static esp_err_t device_read(i2c_master_dev_handle_t device, uint8_t *data_address,
                             uint8_t *data_rd, size_t size, const char *tag) {
    if (device == NULL || data_address == NULL || data_rd == NULL) {
        ESP_LOGE(tag, "device_read con parámetros inválidos");
        return ESP_ERR_INVALID_ARG;
    }
    if (size == 0) {
        return ESP_OK;
    }

    esp_err_t err = i2c_master_transmit(device, data_address, 1, pdMS_TO_TICKS(2000));
    if (err != ESP_OK) {
        ESP_LOGE(tag, "Error al enviar dirección para lectura: %s", esp_err_to_name(err));
        return err;
    }

    err = i2c_master_receive(device, data_rd, size, pdMS_TO_TICKS(2000));
    if (err != ESP_OK) {
        ESP_LOGE(tag, "Error al recibir datos: %s", esp_err_to_name(err));
    }
    return err;
}

/* Escribe `size` bytes a partir del registro `data_address`. */
static esp_err_t device_write(i2c_master_dev_handle_t device, uint8_t *data_address,
                              uint8_t *data_wr, size_t size, const char *tag) {
    if (device == NULL || data_address == NULL || data_wr == NULL) {
        ESP_LOGE(tag, "device_write con parámetros inválidos");
        return ESP_ERR_INVALID_ARG;
    }

    uint8_t full_data[1 + size];
    full_data[0] = *data_address;
    memcpy(&full_data[1], data_wr, size);

    esp_err_t err = i2c_master_transmit(device, full_data, sizeof(full_data), pdMS_TO_TICKS(2000));
    if (err != ESP_OK) {
        ESP_LOGE(tag, "Error al escribir datos: %s", esp_err_to_name(err));
    }
    return err;
}


/*****************************************************************/
/********************** DRIVER BMI270 ****************************/
/*****************************************************************/

/* Handle del slave en el bus I2C. */
static i2c_master_dev_handle_t s_dev = NULL;

/* Configuración por defecto del sensor. */
#define ACC_ODR                 BMI270_ODR_400
#define ACC_AVG                 4
#define ACC_RANGE               8       // fondo de escala del acelerómetro, en g
#define GYR_ODR                 BMI270_ODR_400
#define GYR_RANGE               2000    // fondo de escala del giroscopio, en °/s
#define BMI270_INIT_RETRIES     3

static const char *TAG = "bmi270";
static esp_err_t ret;
static bool is_bmi270_active = false;

/*! @name  Global array that stores the configuration file of BMI270 */
static const uint8_t bmi270_config_file[] = {
    0xc8, 0x2e, 0x00, 0x2e, 0x80, 0x2e, 0x3d, 0xb1, 0xc8, 0x2e, 0x00, 0x2e, 0x80, 0x2e, 0x91, 0x03, 0x80, 0x2e, 0xbc,
    0xb0, 0x80, 0x2e, 0xa3, 0x03, 0xc8, 0x2e, 0x00, 0x2e, 0x80, 0x2e, 0x00, 0xb0, 0x50, 0x30, 0x21, 0x2e, 0x59, 0xf5,
    0x10, 0x30, 0x21, 0x2e, 0x6a, 0xf5, 0x80, 0x2e, 0x3b, 0x03, 0x00, 0x00, 0x00, 0x00, 0x08, 0x19, 0x01, 0x00, 0x22,
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    0x2e, 0x00, 0xc1
};

/* Comprueba la comunicación con el sensor. Realiza reintentos en caso de no
 * devolver el valor esperado: 0x24. */
static esp_err_t chipid(void) {
    uint8_t reg_id = 0x00;
    uint8_t tmp;

    for (int attempt = 1; attempt <= BMI270_INIT_RETRIES; ++attempt) {
        ret = device_read(s_dev, &reg_id, &tmp, 1, TAG);

        if (ret != ESP_OK) {
            ESP_LOGW(TAG, "[%d/%d] Lectura CHIPID falló: %s", attempt, BMI270_INIT_RETRIES, esp_err_to_name(ret));
            vTaskDelay((attempt * 100) / portTICK_PERIOD_MS);
            continue;
        }

        ESP_LOGI(TAG, "Valor de CHIPID: 0x%02X", tmp);

        if (tmp == 0x24) {
            ESP_LOGI(TAG, "Chip reconocido exitosamente");
            return ESP_OK;
        }

        ESP_LOGW(TAG, "[%d/%d] Chip no reconocido. CHIP ID: 0x%02X", attempt, BMI270_INIT_RETRIES, tmp);
        vTaskDelay((attempt * 100) / portTICK_PERIOD_MS);
    }

    ESP_LOGE(TAG, "Verificación CHIPID agotó reintentos");
    return ESP_ERR_INVALID_RESPONSE;
}

/* Realiza soft reset del sensor. Realiza varios reintentos en caso de fallar. */
static esp_err_t softreset(void) {
    uint8_t reg_softreset = 0x7E;
    uint8_t val_softreset = 0xB6;

    for (int attempt = 1; attempt <= BMI270_INIT_RETRIES; ++attempt) {
        ret = device_write(s_dev, &reg_softreset, &val_softreset, 1, TAG);

        if (ret != ESP_OK) {
            ESP_LOGW(TAG, "Intento %d/%d softreset BMI270 falló: %s", attempt, BMI270_INIT_RETRIES, esp_err_to_name(ret));
            vTaskDelay(100 / portTICK_PERIOD_MS);
            continue;
        }

        ESP_LOGI(TAG, "Softreset BMI270: OK");
        vTaskDelay(pdMS_TO_TICKS(200));
        return ESP_OK;
    }

    ESP_LOGE(TAG, "Softreset BMI270 agotó reintentos");
    return ret;
}

/* Inicializa el sensor. */
static void initialization(void) {
    uint8_t reg_pwr_conf_advpowersave = 0x7C;
    uint8_t val_pwr_conf_advpowersave = 0x00;
    uint8_t reg_init_ctrl = 0x59;
    uint8_t val_init_ctrl = 0x00; 
    uint8_t val_init_ctrl2 = 0x01;
    uint8_t reg_init_data = 0x5E;

    ESP_LOGI(TAG, "Inicializando BMI270...");

    ret = device_write(s_dev, &reg_pwr_conf_advpowersave, &val_pwr_conf_advpowersave, 1, TAG);
    if (ret != ESP_OK) {
        ESP_LOGE(TAG, "Error escribiendo pwr_conf_advpowersave: %s", esp_err_to_name(ret));
        return;
    }
    vTaskDelay(500 /portTICK_PERIOD_MS);    // se puede reducir
    
    ret = device_write(s_dev, &reg_init_ctrl, &val_init_ctrl, 1, TAG);
    if (ret != ESP_OK) {
        ESP_LOGE(TAG, "Error escribiendo init_ctrl=0: %s", esp_err_to_name(ret));
        return;
    }

    int config_size = sizeof(bmi270_config_file);
    ret = device_write(s_dev, &reg_init_data, (uint8_t*)bmi270_config_file, config_size, TAG);

    if(ret != ESP_OK) {
        ESP_LOGE(TAG, "Error cargando config_file");
    }
    else {
        ESP_LOGI(TAG, "Config_file cargado.");
    }

    vTaskDelay(500 /portTICK_PERIOD_MS);
    ret = device_write(s_dev, &reg_init_ctrl, &val_init_ctrl2, 1, TAG);
    if (ret != ESP_OK) {
        ESP_LOGE(TAG, "Error escribiendo init_ctrl=1: %s", esp_err_to_name(ret));
        return;
    }

    ESP_LOGI(TAG, "Algoritmo de inicializacion BMI270 finalizado.");
}

/* Chequea que el sensor esté correctamente inicializado. */
static void check_initialization(void){
    uint8_t reg_internalstatus = 0x21;
    uint8_t tmp;
    
    vTaskDelay(500 /portTICK_PERIOD_MS);

    ret = device_read(s_dev,  &reg_internalstatus, &tmp, 1, TAG);
    if (ret != ESP_OK) {
        ESP_LOGE(TAG, "Error leyendo internal status para check_initialization: %s", esp_err_to_name(ret));
        return;
    }
    ESP_LOGI(TAG, "Init_status.0: %x", (tmp & 0b00001111));

    if ((tmp & 0b00001111) == 1) {
        ESP_LOGI(TAG, "Comprobacion Inicializacion BMI270: OK");
        is_bmi270_active = true;
    }
    else {
        ESP_LOGE(TAG, "Error en la inicialización BMI270.");
        return;
    }
}

/* Consulta por el estado interno del sensor. */
static void internal_status(void) {
    uint8_t reg_internalstatus=0x21;
    uint8_t tmp;

    ret = device_read(s_dev,  &reg_internalstatus, &tmp, 1, TAG);
    if (ret != ESP_OK) {
        ESP_LOGE(TAG, "Error leyendo internal status: %s", esp_err_to_name(ret));
        return;
    }
    // Log de depuración eliminado.
    ESP_LOGI(TAG, "Internal Status BMI270: %2X", tmp);

}

/* Habilita y deshabilita sensores auxiliar, giroscopio, acelerómetro y temperatura. 
 * Cada parámetro recibe solo 1's o 0's. */
static void toggle_sensors(int aux, int gyr, int acc, int temp) {
    uint8_t reg_pwr_ctrl = 0x7D;
    uint8_t val_pwr_ctrl;

    if ((aux != 0 && aux != 1) || (gyr != 0 && gyr != 1) || (acc != 0 && acc != 1) || (temp != 0 && temp != 1)) {
        ESP_LOGE(TAG, "PARÁMETRO INCORRECTO EN FUNCIÓN toggle_sensors.");
    }

    val_pwr_ctrl = (temp << 3) | (acc << 2) | (gyr << 1) | aux;

    ret = device_write(s_dev, &reg_pwr_ctrl, &val_pwr_ctrl, 1, TAG);
    if (ret != ESP_OK) {
        ESP_LOGE(TAG, "Error escribiendo pwr_ctrl: %s", esp_err_to_name(ret));
    }
}

/* Configura el acelerómetro. Variables son ODR, AVG y RANGE. Revisar datasheet
 * para ver las configuraciones disponibles. */
static void acc_conf(int odr_set, int avg_set, int range_set) {
    uint8_t reg_acc_conf = 0x40;
    uint8_t val_acc_conf;
    uint8_t reg_acc_range = 0x41;
    uint8_t val_acc_range;
    uint8_t odr, avg, range; 

    switch (odr_set) {
        case BMI270_ODR_12_5:
            odr = 0x05;
            break;
        case BMI270_ODR_25:
            odr = 0x06;
            break;
        case BMI270_ODR_50:
            odr = 0x07;
            break;
        case BMI270_ODR_100:
            odr = 0x08;
            break;
        case BMI270_ODR_200:
            odr = 0x09;
            break;
        case BMI270_ODR_400:
            odr = 0x0A;
            break;
        case BMI270_ODR_800:
            odr = 0x0B;
            break;
        case BMI270_ODR_1600:
            odr = 0x0C;
            break;
        default:
            ESP_LOGE(TAG, "FRECUENCIA DE MUESTREO ACELERÓMETRO BMI270 INCORRECTO.");
            return;
    }
    
    switch (avg_set) {
        case 0:
            avg = 0x00;
            break;
        case 2:
            avg = 0x01;
            break;
        case 4:
            avg = 0x02;
            break;
        case 8:
            avg = 0x03;
            break;
        case 16:
            avg = 0x04;
            break;
        case 32:
            avg = 0x05;
            break;
        case 64:
            avg = 0x06;
            break;
        case 128:
            avg = 0x07;
            break;
        default:
            ESP_LOGE(TAG, "PROMEDIO DE MUESTRAS ACELERÓMETRO BMI270 INCORRECTO.");
            return;
    }

    switch (range_set) {
        case 2:
            range = 0x00;
            break;
        case 4:
            range = 0x01;
            break;
        case 8:
            range = 0x02;
            break;
        case 16:
            range = 0x03;
            break;
        default:
            ESP_LOGE(TAG, "RANGO ACELERÓMETRO BMI270 INCORRECTO.");
            return;
    }

    // 0x08 activa el filtro en modo performance (por defecto)
    val_acc_conf = ((0x08 | avg) << 4) | odr;
    val_acc_range = range;

    // Configuración general del acc
    ret = device_write(s_dev, &reg_acc_conf, &val_acc_conf, 1, TAG);
    if (ret != ESP_OK) {
        ESP_LOGE(TAG, "Error escribiendo acc_conf: %s", esp_err_to_name(ret));
        return;
    }
    
    // Set range
    ret = device_write(s_dev, &reg_acc_range, &val_acc_range, 1, TAG);
    if (ret != ESP_OK) {
        ESP_LOGE(TAG, "Error escribiendo acc_range: %s", esp_err_to_name(ret));
        return;
    }

    vTaskDelay(100 /portTICK_PERIOD_MS);   
}

/* Configura el giroscopio. Variables son ODR Y AVG. Revisar datasheet
 * para ver las configuraciones disponibles. */
static void gyr_conf(int odr_set, int range_set) {
    uint8_t reg_gyr_conf = 0x42;
    uint8_t reg_gyr_range = 0x43;
    uint8_t val_gyr_conf;
    uint8_t val_gyr_range;
    uint8_t odr, range; 

    switch (odr_set) {
        case BMI270_ODR_12_5:
            odr = 0x05;
            break;
        case BMI270_ODR_25:
            odr = 0x06;
            break;
        case BMI270_ODR_50:
            odr = 0x07;
            break;
        case BMI270_ODR_100:
            odr = 0x08;
            break;
        case BMI270_ODR_200:
            odr = 0x09;
            break;
        case BMI270_ODR_400:
            odr = 0x0A;
            break;
        case BMI270_ODR_800:
            odr = 0x0B;
            break;
        case BMI270_ODR_1600:
            odr = 0x0C;
            break;
        case BMI270_ODR_3200:
            odr = 0x0D;
            break;
        default:
            ESP_LOGE(TAG, "FRECUENCIA DE MUESTREO GIROSCOPIO BMI270 INCORRECTO.");
            return;
    }

    switch (range_set) {
        case 2000:
            range = 0x00;
            break;
        case 1000:
            range = 0x01;
            break;
        case 500:
            range = 0x02;
            break;
        case 250:
            range = 0x03;
            break;
        case 125:
            range = 0x04;
            break;            
        default:
            ESP_LOGE(TAG, "RANGO GIROSCOPIO BMI270 INCORRECTO.");
            return;
    }

    // 0xA0 ajusta los modos de performance y filtro (default conf)
    val_gyr_conf = 0xA0 | odr;
    val_gyr_range = range;

    // Configuración general del gyr
    ret = device_write(s_dev, &reg_gyr_conf, &val_gyr_conf, 1, TAG);
    if (ret != ESP_OK) {
        ESP_LOGE(TAG, "Error escribiendo gyr_conf: %s", esp_err_to_name(ret));
        return;
    }

    // Set range
    ret = device_write(s_dev, &reg_gyr_range, &val_gyr_range, 1, TAG);
    if (ret != ESP_OK) {
        ESP_LOGE(TAG, "Error escribiendo gyr_range: %s", esp_err_to_name(ret));
        return;
    }

    vTaskDelay(100 /portTICK_PERIOD_MS);   
}

/* Administra la power config. El sensor queda listo para realizar lecturas. */
void power_config(void) {
    uint8_t reg_pwr_conf = 0x7C;
    uint8_t val_pwr_conf = 0x00;

    ret = device_write(s_dev, &reg_pwr_conf, &val_pwr_conf, 1, TAG);
    if (ret != ESP_OK) {
        ESP_LOGE(TAG, "Error escribiendo power_config: %s", esp_err_to_name(ret));
    }
}

/* Extrae datos de aceleración y giroscopio del sensor BMI270, los procesa 
 * e imprime en la salida estándar. Se puede implementar lectura de temperatura. */
esp_err_t bmi270_read(bmi270_reading_t *out) {
    if (out == NULL) {
        return ESP_ERR_INVALID_ARG;
    }

    // No lee nada si el sensor está inactivo
    if (!is_bmi270_active) {
        ESP_LOGW(TAG, "Sensor BMI270 inactivo. Omitiendo lectura.");
        return ESP_ERR_INVALID_STATE;
    }

    uint8_t reg_intstatus = 0x03, tmp;
    int bytes_data8 = 12;
    uint8_t reg_data = 0x0C, sensor_data_buffer[bytes_data8];

    uint16_t acc_x, acc_y, acc_z;
    uint16_t gyr_x, gyr_y, gyr_z;

    float acc_x_ms2, acc_y_ms2, acc_z_ms2;
    float acc_x_g, acc_y_g, acc_z_g;
    float gyr_x_rads, gyr_y_rads, gyr_z_rads;

    ret = device_read(s_dev, &reg_intstatus, &tmp, 1, TAG);
    if (ret != ESP_OK) {
        ESP_LOGE(TAG, "Error leyendo intstatus: %s", esp_err_to_name(ret));
        return ret;
    }

    // Data ready condition
    if ((tmp & 0b10000000) != 0x80) {
        // Todavía no hay muestra nueva; no es un fallo, pero tampoco hay dato.
        return ESP_ERR_NOT_FINISHED;
    }

    {
        ret = device_read(s_dev, &reg_data, (uint8_t*) sensor_data_buffer, bytes_data8, TAG);
        if (ret != ESP_OK) {
            ESP_LOGE(TAG, "Error leyendo datos de acelerómetro y giroscopio: %s", esp_err_to_name(ret));
            return ret;
        }

        // Valores brutos aceleración y giroscopio
        acc_x = ((uint16_t) sensor_data_buffer[1] << 8) | (uint16_t) sensor_data_buffer[0];
        acc_y = ((uint16_t) sensor_data_buffer[3] << 8) | (uint16_t) sensor_data_buffer[2];
        acc_z = ((uint16_t) sensor_data_buffer[5] << 8) | (uint16_t) sensor_data_buffer[4];
        gyr_x = ((uint16_t) sensor_data_buffer[7] << 8) | (uint16_t) sensor_data_buffer[6];
        gyr_y = ((uint16_t) sensor_data_buffer[9] << 8) | (uint16_t) sensor_data_buffer[8];
        gyr_z = ((uint16_t) sensor_data_buffer[11] << 8) | (uint16_t) sensor_data_buffer[10];

        /* CONVERSIÓN CON CONSTANTES FIJAS
         *
         * El chip entrega cada eje como un int16 que cubre +/- el fondo de
         * escala configurado, así que estas tres constantes SOLO valen para los
         * rangos que programa este archivo:
         *
         *     78.4532  = 8 g * 9.80665      -> vale si ACC_RANGE es 8
         *     8.000    = 8 g                -> idem
         *     34.90659 = 2000 deg/s en rad  -> vale si GYR_RANGE es 2000
         *
         * Si se cambia ACC_RANGE o GYR_RANGE arriba, hay que cambiar también
         * estos números o las lecturas salen escaladas por el factor entre los
         * dos rangos. Con GYR_RANGE en 500, por ejemplo, el giroscopio saldría
         * 4x más grande de lo real (2000/500). */

        // Aceleración en m/s2
        acc_x_ms2 = (int16_t)acc_x*(78.4532/32768);
        acc_y_ms2 = (int16_t)acc_y*(78.4532/32768);
        acc_z_ms2 = (int16_t)acc_z*(78.4532/32768);

        // Aceleración en g
        acc_x_g = (int16_t)acc_x*(8.000/32768);
        acc_y_g = (int16_t)acc_y*(8.000/32768);
        acc_z_g = (int16_t)acc_z*(8.000/32768);

        // Giroscopio en rad/s
        gyr_x_rads = (int16_t)gyr_x*(34.90659/32768);
        gyr_y_rads = (int16_t)gyr_y*(34.90659/32768);
        gyr_z_rads = (int16_t)gyr_z*(34.90659/32768);
        
        ESP_LOGI(TAG, "acc_x: %f m/s2     acc_y: %f m/s2     acc_z: %f m/s2", acc_x_ms2, acc_y_ms2, acc_z_ms2);
        ESP_LOGI(TAG, "acc_x: %f g     acc_y: %f g     acc_z: %f g", acc_x_g, acc_y_g, acc_z_g);
        ESP_LOGI(TAG, "gyr_x: %f rad/s     gyr_y: %f rad/s      gyr_z: %f rad/s", gyr_x_rads, gyr_y_rads, gyr_z_rads);

        out->acc_x_ms2  = acc_x_ms2;
        out->acc_y_ms2  = acc_y_ms2;
        out->acc_z_ms2  = acc_z_ms2;
        out->gyr_x_rads = gyr_x_rads;
        out->gyr_y_rads = gyr_y_rads;
        out->gyr_z_rads = gyr_z_rads;
    }

    return ESP_OK;
}

/* Función para ser llamada desde script main. */
esp_err_t bmi270_init(i2c_master_bus_handle_t bus, int acc_odr, int acc_avg, int acc_range, int gyr_odr, int gyr_range) {
    /* Se agrega al bus que entrega la aplicación. freq_hz = 0 -> usa la
     * velocidad por defecto configurada en i2c_master_init. */
    esp_err_t add_ret = i2c_slave_init(&bus, &s_dev, BMI270_SLAVE_ADDR, 0);
    if (add_ret != ESP_OK) {
        ESP_LOGE(TAG, "No se pudo agregar el slave al bus I2C: %s", esp_err_to_name(add_ret));
        return add_ret;
    }

    is_bmi270_active = false;

    ret = softreset();
    if (ret != ESP_OK) {
        ESP_LOGE(TAG, "Init abortada: softreset falló (%s)", esp_err_to_name(ret));
        return ret;
    }

    ret = chipid();
    if (ret != ESP_OK) {
        ESP_LOGE(TAG, "Init abortada: CHIPID inválido (%s)", esp_err_to_name(ret));        return ret;
    }

    initialization();
    check_initialization();
    toggle_sensors(0, 1, 1, 0);
    acc_conf(acc_odr, acc_avg, acc_range);
    gyr_conf(gyr_odr, gyr_range);
    power_config();
    internal_status();

    return ESP_OK;
}

/* Saca el sensor del bus y anula su handle. */
esp_err_t bmi270_deinit(void) {
    is_bmi270_active = false;
    return i2c_slave_deinit(&s_dev);
}


/*****************************************************************/
/******************** RED Y ADQUISICIÓN **************************/
/*****************************************************************/

/* Todo lo que sigue se agregó al driver original para hablar con el servidor
 * (web_server.py). Es el mismo protocolo de protocol.py, y hace lo mismo que
 * esp_test.py, pero con el sensor real:
 *
 *   1. CONTROL (TCP, puerto 10001): el ESP32 se conecta, recibe CONFIG
 *      (9 bytes), lo valida y responde un ACK (1 byte).
 *   2. Programa el rango y la frecuencia pedidos en el acelerómetro.
 *   3. DATOS (TCP o UDP, puerto 10000): envía muestras de 14 bytes hasta
 *      completar `limit` muestras (STOP_BY_COUNT) o hasta que pasen `limit`
 *      milisegundos según su propio reloj (STOP_BY_TIME).
 *   4. FIN: envía END por el canal de control (6 bytes: 0xFF, cómo terminó
 *      la sesión y el total de muestras tomadas). Con TCP además se cierra la
 *      conexión de datos.
 *   5. Vuelve a 1 por la MISMA conexión de control: espera el siguiente CONFIG.
 *
 * Durante la adquisición el servidor puede enviar STOP (0xFE, 1 byte) por el
 * canal de control: el ESP32 lo revisa entre muestras y, si llega, termina la
 * sesión igual que si hubiera llegado al límite, con END_STOPPED en el END.
 *
 * WIFI_SSID, WIFI_PASS y SERVER_IP están en main/secrets.h. */

#define CONTROL_PORT            10001
#define DATA_PORT               10000

#define TRANSPORT_TCP           0
#define TRANSPORT_UDP           1
#define MODE_SEQUENTIAL         0
#define MODE_PARALLEL           1
#define STOP_BY_COUNT           0       // la sesión termina tras `limit` muestras
#define STOP_BY_TIME            1       // la sesión termina tras `limit` milisegundos
#define MAX_DURATION_MS         3600000 // 1 hora: la sesión por tiempo más larga que se acepta

/* Códigos del ACK y de END: los mismos de protocol.py. */
#define ACK_OK                  0
#define ERR_RANGE               1
#define ERR_RATE                2
#define ERR_TRANSPORT           3
#define ERR_MODE                4
#define ERR_SAMPLES             5
#define ERR_STOP                6
#define ERR_DURATION            7
#define END_CODE                0xFF
/* Cómo terminó la sesión: segundo byte de END */
#define END_COMPLETED           0       // llegó a N muestras o a T segundos
#define END_STOPPED             1       // el servidor envió STOP
#define END_FAILED              2       // falló el sensor o el envío de datos
#define STOP_CODE               0xFE    // servidor -> ESP32: terminar la sesión ya

/* 1 = una sola sesión por encendido: al terminar, el ESP32 se queda quieto
 *     hasta que se presione RESET.
 * 0 = al terminar sigue conectado y espera el siguiente CONFIG. Es lo que
 *     necesita la página web (web_server.py), que envía CONFIG solo cuando se
 *     presiona Start. */
#define ONE_SESSION_PER_BOOT    0

#define RECONNECT_DELAY_MS      2000    // espera antes de reintentar la conexión de control
#define NO_DATA_TIMEOUT_US      2000000 // si el sensor no entrega nada en 2 s, se corta la sesión
#define PARALLEL_QUEUE_LEN      512     // muestras que caben en la cola del modo paralelo
#define FIFO_POLL_MS            5       // cada cuánto se vacía la FIFO del sensor

/* Los dos mensajes binarios. `packed` evita que el compilador agregue relleno:
 * sin él, la muestra mediría 16 bytes en vez de 14 y el servidor leería basura.
 * El ESP32 es little-endian, igual que '<' en struct de Python. */
typedef struct __attribute__((packed)) {
    uint8_t  range_g;       // 2, 4, 8 o 16
    uint8_t  odr_code;      // código de registro del BMI270: 0x05 (12.5 Hz) ... 0x0C (1600 Hz)
    uint8_t  transport;     // TRANSPORT_TCP o TRANSPORT_UDP
    uint8_t  read_mode;     // MODE_SEQUENTIAL o MODE_PARALLEL
    uint8_t  stop_mode;     // STOP_BY_COUNT o STOP_BY_TIME: qué significa `limit`
    uint32_t limit;         // muestras (por cantidad) o milisegundos (por tiempo)
} control_config_t;         // '<BBBBBI' en protocol.py

typedef struct __attribute__((packed)) {
    uint32_t seq;           // número de muestra; parte en 0 en cada sesión
    uint32_t t_us;          // reloj del ESP32 en microsegundos (da la vuelta cada 71.6 min)
    int16_t  ax;            // valores crudos del sensor
    int16_t  ay;
    int16_t  az;
} data_msg_t;               // '<IIhhh' en protocol.py

typedef struct __attribute__((packed)) {
    uint8_t  code;          // END_CODE
    uint8_t  result;        // END_COMPLETED, END_STOPPED o END_FAILED
    uint32_t total;         // muestras tomadas: seq de 0 a total-1
} end_msg_t;                // '<BBI' en protocol.py

_Static_assert(sizeof(control_config_t) == 9,  "CONFIG debe medir 9 bytes");
_Static_assert(sizeof(data_msg_t) == 14,       "la muestra debe medir 14 bytes");
_Static_assert(sizeof(end_msg_t) == 6,         "END debe medir 6 bytes");


/* ------------------------------- WiFi -------------------------------- */

static EventGroupHandle_t wifi_event_group;
#define WIFI_CONNECTED_BIT BIT0

static void event_handler(void* arg, esp_event_base_t event_base, int32_t event_id, void* event_data) {
    if (event_base == WIFI_EVENT && event_id == WIFI_EVENT_STA_START) {
        esp_wifi_connect();
    } else if (event_base == WIFI_EVENT && event_id == WIFI_EVENT_STA_DISCONNECTED) {
        wifi_event_sta_disconnected_t *d = (wifi_event_sta_disconnected_t *)event_data;
        ESP_LOGW(TAG, "WiFi desconectado (motivo %d). Reintentando...", d->reason);
        esp_wifi_connect();
    } else if (event_base == IP_EVENT && event_id == IP_EVENT_STA_GOT_IP) {
        ip_event_got_ip_t *e = (ip_event_got_ip_t *)event_data;
        ESP_LOGI(TAG, "IP del ESP32: " IPSTR, IP2STR(&e->ip_info.ip));
        xEventGroupSetBits(wifi_event_group, WIFI_CONNECTED_BIT);
    }
}

static void wifi_init_sta(void) {
    esp_err_t ret_nvs = nvs_flash_init();
    if (ret_nvs == ESP_ERR_NVS_NO_FREE_PAGES || ret_nvs == ESP_ERR_NVS_NEW_VERSION_FOUND) {
        ESP_ERROR_CHECK(nvs_flash_erase());
        ret_nvs = nvs_flash_init();
    }
    ESP_ERROR_CHECK(ret_nvs);
    wifi_event_group = xEventGroupCreate();
    ESP_ERROR_CHECK(esp_netif_init());
    ESP_ERROR_CHECK(esp_event_loop_create_default());
    esp_netif_create_default_wifi_sta();
    wifi_init_config_t cfg = WIFI_INIT_CONFIG_DEFAULT();
    ESP_ERROR_CHECK(esp_wifi_init(&cfg));
    esp_event_handler_instance_register(WIFI_EVENT, ESP_EVENT_ANY_ID, &event_handler, NULL, NULL);
    esp_event_handler_instance_register(IP_EVENT, IP_EVENT_STA_GOT_IP, &event_handler, NULL, NULL);
    wifi_config_t wifi_config = {
        .sta = {
            .ssid = WIFI_SSID,
            .password = WIFI_PASS,
        },
    };
    ESP_ERROR_CHECK(esp_wifi_set_mode(WIFI_MODE_STA));
    ESP_ERROR_CHECK(esp_wifi_set_config(WIFI_IF_STA, &wifi_config));
    ESP_ERROR_CHECK(esp_wifi_start());
    ESP_LOGI(TAG, "Conectando a WiFi (%s)...", WIFI_SSID);
    xEventGroupWaitBits(wifi_event_group, WIFI_CONNECTED_BIT, pdFALSE, pdTRUE, portMAX_DELAY);
    ESP_LOGI(TAG, "WiFi conectado!");
}


/* ------------------------ Enviar y recibir --------------------------- */

/* Recibe exactamente `len` bytes. TCP entrega un flujo de bytes, no mensajes:
 * un recv() puede devolver menos de lo pedido. Es el recv_exact de Python.
 * Devuelve false si el servidor cerró la conexión o hubo un error. */
static bool recv_exact(int sock, void *buf, size_t len) {
    uint8_t *p = (uint8_t *)buf;
    size_t got = 0;
    while (got < len) {
        int r = recv(sock, p + got, len - got, 0);
        if (r <= 0) {
            return false;
        }
        got += (size_t)r;
    }
    return true;
}

/* Envía exactamente `len` bytes por un socket TCP. Devuelve false si falla. */
static bool send_all(int sock, const void *buf, size_t len) {
    const uint8_t *p = (const uint8_t *)buf;
    size_t sent = 0;
    while (sent < len) {
        int r = send(sock, p + sent, len - sent, 0);
        if (r <= 0) {
            return false;
        }
        sent += (size_t)r;
    }
    return true;
}

static uint32_t s_udp_send_errors = 0;

/* Envía una muestra por el canal de datos. Devuelve false solo si hay que
 * cortar la sesión (la conexión TCP se cayó). */
static bool send_sample(int data_sock, uint8_t transport, const struct sockaddr_in *dest,
                        const data_msg_t *msg) {
    if (transport == TRANSPORT_TCP) {
        return send_all(data_sock, msg, sizeof(*msg));
    }
    /* UDP: un datagrama por muestra. Si no se puede enviar (por ejemplo, con
     * los buffers del WiFi llenos) la muestra simplemente se pierde, y el
     * servidor lo verá como un hueco en seq. No es motivo para cortar. */
    if (sendto(data_sock, msg, sizeof(*msg), 0, (const struct sockaddr *)dest, sizeof(*dest)) < 0) {
        s_udp_send_errors++;
    }
    return true;
}

/* ¿Pidió el servidor terminar la sesión? Mira el canal de control SIN esperar
 * (MSG_DONTWAIT): si no llegó nada, recv() falla con EAGAIN y se sigue normal.
 * También se termina si el servidor cerró el control o la conexión se cayó. */
static bool stop_requested(int control_sock) {
    uint8_t b;
    int r = recv(control_sock, &b, 1, MSG_DONTWAIT);
    if (r == 1) {
        return b == STOP_CODE;              // otro byte: se ignora
    }
    if (r == 0) {
        return true;                        // el servidor cerró la conexión
    }
    return errno != EAGAIN && errno != EWOULDBLOCK;
}

/* Recibe un CONFIG. Un STOP que llegó tarde (cuando la sesión ya había
 * terminado sola) quedó esperando en el socket: se descarta. No se confunde
 * con un CONFIG porque su primer byte es el rango (2, 4, 8 o 16), nunca 0xFE. */
static bool recv_config(int control_sock, control_config_t *cfg) {
    uint8_t *p = (uint8_t *)cfg;
    do {
        if (!recv_exact(control_sock, p, 1)) {
            return false;
        }
    } while (p[0] == STOP_CODE);
    return recv_exact(control_sock, p + 1, sizeof(*cfg) - 1);
}


/* ----------------------------- Sensor -------------------------------- */

/* Las muestras se leen de la FIFO del BMI270: una memoria de 2048 bytes
 * dentro del sensor donde él mismo va guardando cada muestra, a su ritmo.
 * El ESP32 la vacía cada FIFO_POLL_MS y lee muchas muestras en una sola
 * transferencia I2C, en vez de preguntar "¿hay muestra nueva?" y leer 6
 * bytes por cada una. Así se alcanzan los 1600 Hz:
 *   - Sin FIFO, cada muestra costaba ~2 ms de I2C y esperas: el máximo real
 *     era ~350 Hz, y las muestras que el sensor sobrescribía no se notaban.
 *   - Con FIFO, a 1600 Hz cada lectura trae ~8 muestras (56 bytes) cada 5 ms,
 *     y si el envío se atrasa, la FIFO guarda hasta ~180 ms de muestras.
 *   - Por eso el bus I2C va a 400 kHz (I2C_MASTER_FREQ_HZ): a 1600 Hz son
 *     ~11 KB/s, lo máximo que mueve un bus de 100 kHz. A 400 kHz usa ~25 %.
 *
 * Registros (datasheet del BMI270 y bmi2_defs.h de Bosch): */
#define REG_FIFO_LENGTH         0x24    // 2 bytes: bytes guardados (14 bits)
#define REG_FIFO_DATA           0x26    // leer aquí en ráfaga entrega la FIFO
#define REG_FIFO_DOWNS          0x45
#define REG_FIFO_CONFIG_0       0x48
#define REG_FIFO_CONFIG_1       0x49
#define REG_CMD                 0x7E

#define FIFO_DOWNS_FILTERED     0x88    // muestras filtradas a la frecuencia elegida (acc y gyr),
                                        // no las crudas a 1600 Hz fijos
#define FIFO_CONFIG_0_STREAM    0x00    // llena: se pierden las más antiguas (y lo avisa)
#define FIFO_CONFIG_1_ACC_HDR   0x50    // 0x40 solo acelerómetro + 0x10 con encabezados
#define CMD_FIFO_FLUSH          0xB0    // vaciar la FIFO

/* Encabezados de los "frames" (bloques) que salen de la FIFO */
#define FRAME_ACC               0x84    // + 6 bytes: x, y, z (int16 little-endian)
#define FRAME_SKIP              0x40    // + 1 byte: cuántas muestras se perdieron por FIFO llena
#define FRAME_SENSORTIME        0x44    // + 3 bytes (no se usa, pero hay que saltarlo)
#define FRAME_CONFIG_CHANGE     0x48    // + 4 bytes (no se usa, pero hay que saltarlo)
#define FRAME_OVER_READ         0x80    // ya no hay más datos

#define FIFO_SIZE               2048
#define FIFO_MAX_FRAMES         (FIFO_SIZE / 7)     // 7 bytes por muestra con su encabezado

static uint8_t s_fifo_buf[FIFO_SIZE];               // lo leído de la FIFO
static data_msg_t s_batch[FIFO_MAX_FRAMES];         // las muestras listas para enviar
/* Auxiliares de fifo_take(). Son static (no van en el stack) porque juntas
 * ocupan ~4 KB, todo el stack de read_task en el modo paralelo. */
static int16_t s_raw[FIFO_MAX_FRAMES][3];           // x, y, z de cada muestra leída
static int64_t s_t_us[FIFO_MAX_FRAMES];             // su t_us
static int64_t s_last_t_us = -1;                    // t_us de la última muestra (-1: ninguna)
static int64_t s_session_start_us = 0;              // cuándo empezó la sesión (para el modo por tiempo)
static int64_t s_period_us = 0;                     // periodo nominal: 1 / frecuencia

/* Escribe un registro de 1 byte del BMI270. */
static esp_err_t write_reg(uint8_t reg, uint8_t value) {
    return device_write(s_dev, &reg, &value, 1, TAG);
}

/* Prepara la FIFO al empezar una sesión: solo acelerómetro, con
 * encabezados, y la vacía para que no queden muestras de antes. */
static esp_err_t fifo_start(int odr_macro) {
    s_period_us = (odr_macro == BMI270_ODR_12_5) ? 80000 : 1000000 / odr_macro;
    s_last_t_us = -1;

    esp_err_t err = write_reg(REG_FIFO_DOWNS, FIFO_DOWNS_FILTERED);
    if (err == ESP_OK) err = write_reg(REG_FIFO_CONFIG_0, FIFO_CONFIG_0_STREAM);
    if (err == ESP_OK) err = write_reg(REG_FIFO_CONFIG_1, FIFO_CONFIG_1_ACC_HDR);
    if (err == ESP_OK) err = write_reg(REG_CMD, CMD_FIFO_FLUSH);
    vTaskDelay(pdMS_TO_TICKS(2));
    return err;
}

/* Les pone t_us a las `n` muestras recién leídas. El sensor no dice CUÁNDO
 * tomó cada una, pero sí que van una cada periodo (s_period_us). Se usa:
 *   - La más nueva se tomó hace "medio intervalo" antes de leer, en promedio
 *     (el intervalo es el periodo, o FIFO_POLL_MS si este es más corto).
 *   - La primera vez se cuenta hacia atrás desde ahí, un periodo por muestra.
 *   - Después, cada muestra va un periodo después de la anterior, más una
 *     pequeña corrección: una fracción (1/TIME_SMOOTHING) de lo que la cuenta
 *     se desvió de la estimación. Así el intervalo queda casi constante, nunca
 *     va hacia atrás, y en promedio sigue al reloj del ESP32 (si el sensor va
 *     1 % rápido, se nota en el intervalo medio).
 * Las `skipped` (perdidas en el sensor) también ocupan su lugar en el tiempo.
 * Si la cuenta quedó MUY atrás (por ejemplo, después de que la FIFO se llenó
 * porque el envío se atrasó), se vuelve a anclar al reloj de una vez. */
#define TIME_SMOOTHING          8
#define TIME_REANCHOR_US        20000   // atraso que ya no se corrige de a poco

/* Cuándo se tomó, en promedio, la muestra más nueva de una lectura hecha en
 * t_read_us: medio intervalo antes (el periodo, o FIFO_POLL_MS si es menor). */
static int64_t newest_sample_us(int64_t t_read_us) {
    int64_t poll_us = (int64_t)FIFO_POLL_MS * 1000;
    return t_read_us - (s_period_us < poll_us ? s_period_us : poll_us) / 2;
}

static void stamp_batch(int n, uint32_t skipped, int64_t t_read_us, int64_t *t_us) {
    int64_t newest = newest_sample_us(t_read_us);   // estimación para la más nueva
    int64_t steps = (int64_t)skipped + n;
    int64_t error = (s_last_t_us < 0) ? 0 : newest - (s_last_t_us + steps * s_period_us);

    if (s_last_t_us < 0 || error > TIME_REANCHOR_US) {
        /* Primera vez, o muy atrasados: contar hacia atrás desde la más nueva
         * (sin pasar por encima de la última muestra ya enviada). */
        int64_t first = newest - (int64_t)(n - 1) * s_period_us;
        if (s_last_t_us >= 0 && first <= s_last_t_us) {
            first = s_last_t_us + s_period_us;
        }
        for (int i = 0; i < n; i++) {
            t_us[i] = first + (int64_t)i * s_period_us;
        }
    } else {
        int64_t step = s_period_us + error / (steps * TIME_SMOOTHING);
        if (step < s_period_us / 2) step = s_period_us / 2;     // nunca apretar de más ni retroceder
        if (step > s_period_us * 2) step = s_period_us * 2;     // ni estirar de más
        for (int i = 0; i < n; i++) {
            t_us[i] = s_last_t_us + step * ((int64_t)skipped + i + 1);
        }
    }
    s_last_t_us = t_us[n - 1];
}

/* Una vuelta de lectura: vacía la FIFO y deja en s_batch las muestras ya
 * numeradas (seq) y con su t_us, listas para enviar. *n = cuántas. *done se
 * pone en true cuando la sesión llegó a su límite (N muestras o T segundos).
 * Las muestras perdidas en el sensor (FIFO llena) igual avanzan seq: el
 * servidor ve el hueco y las cuenta como perdidas. */
static esp_err_t fifo_take(const control_config_t *cfg, uint32_t *seq, int *n, bool *done) {
    *n = 0;
    if (!is_bmi270_active) {
        return ESP_ERR_INVALID_STATE;
    }

    /* 1. ¿Cuántos bytes hay? */
    uint8_t reg = REG_FIFO_LENGTH, len_buf[2];
    esp_err_t err = device_read(s_dev, &reg, len_buf, 2, TAG);
    if (err != ESP_OK) {
        return err;
    }
    int64_t t_read_us = esp_timer_get_time();
    size_t length = len_buf[0] | ((size_t)(len_buf[1] & 0x3F) << 8);
    if (length > FIFO_SIZE) {
        length = FIFO_SIZE;
    }

    /* 2. Leerlos todos en una sola transferencia */
    int frames = 0;
    uint32_t skipped = 0;
    bool saturated = false;         // el sensor cuenta hasta 255 perdidas: pudieron ser más
    if (length > 0) {
        reg = REG_FIFO_DATA;
        err = device_read(s_dev, &reg, s_fifo_buf, length, TAG);
        if (err != ESP_OK) {
            return err;
        }

        /* 3. Separar los frames. Si el último quedó cortado, se descarta:
         *    el sensor lo vuelve a entregar completo en la próxima lectura. */
        size_t i = 0;
        while (i < length) {
            uint8_t header = s_fifo_buf[i] & 0xFC;  // los 2 bits bajos son marcas de interrupción
            size_t size;
            if (header == FRAME_ACC)                size = 6;
            else if (header == FRAME_SKIP)          size = 1;
            else if (header == FRAME_SENSORTIME)    size = 3;
            else if (header == FRAME_CONFIG_CHANGE) size = 4;
            else if (header == FRAME_OVER_READ)     break;
            else {
                ESP_LOGW(TAG, "FIFO: encabezado desconocido 0x%02x, se descarta el resto", s_fifo_buf[i]);
                break;
            }
            if (i + 1 + size > length) {
                break;                              // frame cortado
            }
            const uint8_t *p = &s_fifo_buf[i + 1];
            if (header == FRAME_ACC && frames < FIFO_MAX_FRAMES) {
                s_raw[frames][0] = (int16_t)(((uint16_t)p[1] << 8) | p[0]);
                s_raw[frames][1] = (int16_t)(((uint16_t)p[3] << 8) | p[2]);
                s_raw[frames][2] = (int16_t)(((uint16_t)p[5] << 8) | p[4]);
                frames++;
            } else if (header == FRAME_SKIP) {
                skipped += p[0];
                saturated = saturated || p[0] == 0xFF;
            }
            i += 1 + size;
        }
    }

    /* 4. Si el contador de perdidas llegó a 255, se estima cuántas fueron por
     *    el tiempo que pasó: (tiempo desde la última muestra) / periodo. */
    if (saturated && frames > 0 && s_last_t_us >= 0) {
        int64_t gap = newest_sample_us(t_read_us) - s_last_t_us;
        int64_t estimate = gap / s_period_us - frames;
        if (estimate > (int64_t)skipped) {
            skipped = (uint32_t)estimate;
        }
    }

    /* 5. Numerar y poner la hora */
    if (frames > 0) {
        stamp_batch(frames, skipped, t_read_us, s_t_us);
    }
    if (skipped > 0) {
        ESP_LOGW(TAG, "FIFO llena: el sensor descarto %lu muestras", (unsigned long)skipped);
        *seq += skipped;
        if (cfg->stop_mode == STOP_BY_COUNT && *seq >= cfg->limit) {
            *seq = cfg->limit;
            *done = true;
            return ESP_OK;
        }
    }
    int64_t end_us = s_session_start_us + (int64_t)cfg->limit * 1000;   // modo por tiempo
    for (int k = 0; k < frames; k++) {
        if (cfg->stop_mode == STOP_BY_COUNT ? *seq >= cfg->limit : s_t_us[k] >= end_us) {
            *done = true;
            return ESP_OK;
        }
        data_msg_t *msg = &s_batch[*n];
        msg->seq = *seq;
        msg->t_us = (uint32_t)s_t_us[k];
        msg->ax = s_raw[k][0];
        msg->ay = s_raw[k][1];
        msg->az = s_raw[k][2];
        (*seq)++;
        (*n)++;
    }
    /* Por tiempo: si ya pasó T al leer, todo lo anterior a T ya está leído */
    if ((cfg->stop_mode == STOP_BY_COUNT && *seq >= cfg->limit) ||
        (cfg->stop_mode == STOP_BY_TIME && t_read_us >= end_us)) {
        *done = true;
    }
    return ESP_OK;
}

/* Revisa el CONFIG como lo hace validate() en esp_test.py. Devuelve el código
 * para el ACK. Si es válido, deja en *odr_macro el valor que espera acc_conf():
 * por la red viaja el código de registro, pero acc_conf() recibe la macro
 * BMI270_ODR_... */
static uint8_t validate_config(const control_config_t *cfg, int *odr_macro) {
    if (cfg->range_g != 2 && cfg->range_g != 4 && cfg->range_g != 8 && cfg->range_g != 16) {
        return ERR_RANGE;
    }
    switch (cfg->odr_code) {
        case 0x05: *odr_macro = BMI270_ODR_12_5; break;
        case 0x06: *odr_macro = BMI270_ODR_25;   break;
        case 0x07: *odr_macro = BMI270_ODR_50;   break;
        case 0x08: *odr_macro = BMI270_ODR_100;  break;
        case 0x09: *odr_macro = BMI270_ODR_200;  break;
        case 0x0A: *odr_macro = BMI270_ODR_400;  break;
        case 0x0B: *odr_macro = BMI270_ODR_800;  break;
        case 0x0C: *odr_macro = BMI270_ODR_1600; break;
        default:   return ERR_RATE;
    }
    if (cfg->transport != TRANSPORT_TCP && cfg->transport != TRANSPORT_UDP) {
        return ERR_TRANSPORT;
    }
    if (cfg->read_mode != MODE_SEQUENTIAL && cfg->read_mode != MODE_PARALLEL) {
        return ERR_MODE;
    }
    if (cfg->stop_mode == STOP_BY_COUNT) {
        if (cfg->limit == 0) {
            return ERR_SAMPLES;
        }
    } else if (cfg->stop_mode == STOP_BY_TIME) {
        if (cfg->limit == 0 || cfg->limit > MAX_DURATION_MS) {
            return ERR_DURATION;
        }
    } else {
        return ERR_STOP;
    }
    return ACK_OK;
}

/* Programa en el acelerómetro el rango y la frecuencia de la sesión. El sensor
 * ya está inicializado desde el arranque: acá solo se reescriben esos dos
 * registros, así que no hace falta repetir bmi270_init(). */
static bool apply_sensor_config(const control_config_t *cfg, int odr_macro) {
    acc_conf(odr_macro, ACC_AVG, cfg->range_g);
    if (ret != ESP_OK) {    // acc_conf() no devuelve nada: deja su resultado en `ret`
        ESP_LOGE(TAG, "No se pudo configurar el acelerometro: %s", esp_err_to_name(ret));
        return false;
    }
    return true;
}


/* --------------------------- Modo paralelo --------------------------- */

/* Dos tareas unidas por una cola: read_task vacía la FIFO a su ritmo y deja
 * cada muestra en la cola; la tarea principal las saca y las envía. Un envío
 * lento ya no atrasa la lectura.
 *
 * Solo read_task toca el bus I2C mientras dura la adquisición, así que sigue
 * sin hacer falta un mutex de bus. */
static QueueHandle_t s_data_queue = NULL;
static SemaphoreHandle_t s_reader_done = NULL;  // read_task lo entrega justo antes de terminar
static volatile bool s_stop_reader = false;     // la tarea principal pide a read_task que pare
static volatile bool s_reader_failed = false;   // el sensor falló en read_task
static volatile uint32_t s_dropped = 0;         // muestras descartadas por cola llena
static volatile uint32_t s_taken = 0;           // muestras que read_task leyó (seq final)
static bool s_stopped = false;                  // la sesión terminó por un STOP del servidor

static void parallel_read_task(void *arg) {
    const control_config_t *cfg = (const control_config_t *)arg;
    uint32_t seq = 0;
    bool done = false;
    int64_t last_data_us = esp_timer_get_time();

    while (!done && !s_stop_reader) {
        int n;
        esp_err_t err = fifo_take(cfg, &seq, &n, &done);
        if (err != ESP_OK) {
            ESP_LOGE(TAG, "Lectura del sensor fallo: %s", esp_err_to_name(err));
            s_reader_failed = true;
            break;
        }
        s_taken = seq;

        /* Sin espera: si la cola está llena, la muestra se descarta. Como ya
         * tiene su seq, el servidor verá el hueco y lo contará como pérdida.
         * (Esperar acá frenaría la lectura, y la pérdida quedaría oculta.) */
        for (int i = 0; i < n; i++) {
            if (xQueueSend(s_data_queue, &s_batch[i], 0) != pdTRUE) {
                s_dropped++;
            }
        }

        if (n > 0) {
            last_data_us = esp_timer_get_time();
        } else if (esp_timer_get_time() - last_data_us > NO_DATA_TIMEOUT_US) {
            ESP_LOGE(TAG, "El sensor no entrega muestras");
            s_reader_failed = true;
            break;
        }
        if (!done) {
            vTaskDelay(pdMS_TO_TICKS(FIFO_POLL_MS));
        }
    }

    xSemaphoreGive(s_reader_done);
    vTaskDelete(NULL);
}

/* Lado emisor del modo paralelo. Devuelve cuántas muestras se tomaron (el
 * seq final, incluidas las descartadas por cola llena), deja en *sent cuántas
 * se enviaron y en *ok si la sesión terminó bien. */
static uint32_t run_parallel(int data_sock, int control_sock, const control_config_t *cfg,
                             const struct sockaddr_in *dest, uint32_t *sent, bool *ok) {
    *sent = 0;

    s_data_queue = xQueueCreate(PARALLEL_QUEUE_LEN, sizeof(data_msg_t));
    s_reader_done = xSemaphoreCreateBinary();
    s_stop_reader = false;
    s_reader_failed = false;
    s_dropped = 0;
    s_taken = 0;

    if (s_data_queue == NULL || s_reader_done == NULL ||
        xTaskCreatePinnedToCore(parallel_read_task, "read_task", 4096, (void *)cfg, 5, NULL, 1) != pdPASS) {
        ESP_LOGE(TAG, "No se pudo iniciar el modo paralelo (sin memoria)");
        if (s_data_queue != NULL) vQueueDelete(s_data_queue);
        if (s_reader_done != NULL) vSemaphoreDelete(s_reader_done);
        *ok = false;
        return 0;
    }

    bool reader_finished = false;
    while (true) {
        /* STOP: se le pide a read_task que pare. Lo que ya está en la cola
         * se envía igual, y el bucle termina cuando read_task avisa. */
        if (!s_stop_reader && stop_requested(control_sock)) {
            s_stopped = true;
            s_stop_reader = true;
        }

        data_msg_t msg;
        TickType_t wait = reader_finished ? 0 : pdMS_TO_TICKS(50);
        if (xQueueReceive(s_data_queue, &msg, wait) == pdTRUE) {
            if (!send_sample(data_sock, cfg->transport, dest, &msg)) {
                ESP_LOGE(TAG, "Fallo el envio de datos (errno %d)", errno);
                *ok = false;
                break;
            }
            (*sent)++;
            continue;
        }
        if (reader_finished) {
            break;              // cola vacía y ya no va a llegar nada más
        }
        if (xSemaphoreTake(s_reader_done, 0) == pdTRUE) {
            reader_finished = true;     // una vuelta más, para vaciar lo que quedó en la cola
        }
    }

    /* Antes de borrar la cola hay que estar seguro de que read_task terminó. */
    s_stop_reader = true;
    if (!reader_finished) {
        xSemaphoreTake(s_reader_done, portMAX_DELAY);
    }
    vQueueDelete(s_data_queue);
    vSemaphoreDelete(s_reader_done);
    s_data_queue = NULL;
    s_reader_done = NULL;

    if (s_reader_failed) {
        *ok = false;
    }
    if (s_dropped > 0) {
        ESP_LOGW(TAG, "Cola llena: %lu muestras descartadas", (unsigned long)s_dropped);
    }
    return s_taken;
}


/* --------------------------- Modo secuencial ------------------------- */

/* Una sola tarea lee y envía, una cosa después de la otra: vacía la FIFO,
 * envía esas muestras y vuelve a leer. Si un envío se demora, la FIFO del
 * sensor guarda lo que llega mientras tanto (hasta ~180 ms a 1600 Hz).
 * Devuelve cuántas muestras se tomaron y deja en *sent cuántas se enviaron. */
static uint32_t run_sequential(int data_sock, int control_sock, const control_config_t *cfg,
                               const struct sockaddr_in *dest, uint32_t *sent, bool *ok) {
    uint32_t seq = 0;
    bool done = false;
    int64_t last_data_us = esp_timer_get_time();
    *sent = 0;

    while (!done) {
        if (stop_requested(control_sock)) {
            s_stopped = true;
            break;
        }

        int n;
        esp_err_t err = fifo_take(cfg, &seq, &n, &done);
        if (err != ESP_OK) {
            ESP_LOGE(TAG, "Lectura del sensor fallo: %s", esp_err_to_name(err));
            *ok = false;
            break;
        }

        for (int i = 0; i < n; i++) {
            if (!send_sample(data_sock, cfg->transport, dest, &s_batch[i])) {
                ESP_LOGE(TAG, "Fallo el envio de datos (errno %d)", errno);
                *ok = false;
                done = true;
                break;
            }
            (*sent)++;
        }

        if (n > 0) {
            last_data_us = esp_timer_get_time();
        } else if (esp_timer_get_time() - last_data_us > NO_DATA_TIMEOUT_US) {
            ESP_LOGE(TAG, "El sensor no entrega muestras");
            *ok = false;
            break;
        }
        if (!done) {
            vTaskDelay(pdMS_TO_TICKS(FIFO_POLL_MS));
        }
    }
    return seq;
}


/* ------------------------------ Sesión ------------------------------- */

/* Canal de datos: abre el socket, envía las muestras y avisa el final. */
static void run_acquisition(int control_sock, const control_config_t *cfg, int odr_macro,
                            const struct sockaddr_in *server_addr) {
    struct sockaddr_in dest = *server_addr;
    dest.sin_port = htons(DATA_PORT);

    int data_sock = socket(AF_INET, (cfg->transport == TRANSPORT_TCP) ? SOCK_STREAM : SOCK_DGRAM, 0);
    if (data_sock < 0) {
        ESP_LOGE(TAG, "No se pudo crear el socket de datos (errno %d)", errno);
        return;
    }

    if (cfg->transport == TRANSPORT_TCP) {
        if (connect(data_sock, (struct sockaddr *)&dest, sizeof(dest)) != 0) {
            ESP_LOGE(TAG, "Fallo la conexion de datos TCP (errno %d)", errno);
            close(data_sock);
            return;
        }
        ESP_LOGI(TAG, "Conexion TCP de datos establecida");
    } else {
        ESP_LOGI(TAG, "Socket UDP de datos creado");
    }

    bool ok = true;
    uint32_t taken, sent;
    s_udp_send_errors = 0;
    s_stopped = false;

    if (fifo_start(odr_macro) != ESP_OK) {
        ESP_LOGE(TAG, "No se pudo preparar la FIFO del sensor");
        ok = false;
        taken = sent = 0;
    } else {
        s_session_start_us = esp_timer_get_time();     // aquí empieza a correr el tiempo
        if (cfg->read_mode == MODE_SEQUENTIAL) {
            taken = run_sequential(data_sock, control_sock, cfg, &dest, &sent, &ok);
        } else {
            taken = run_parallel(data_sock, control_sock, cfg, &dest, &sent, &ok);
        }
    }
    double seconds = (esp_timer_get_time() - s_session_start_us) / 1e6;

    /* Fin de la sesión: END por el canal de control, con TCP y con UDP.
     * - Dice CÓMO terminó: completa, detenida por STOP o con una falla. Con
     *   TCP, cerrar la conexión de datos no basta: el servidor no podría
     *   distinguir un final normal de uno temprano.
     * - Lleva el total de muestras tomadas: en el modo por tiempo es la única
     *   forma de que el servidor sepa cuántas esperar (y cuántas se perdieron).
     * Se envía aunque la sesión haya terminado mal, para que el servidor no se
     * quede esperando. Después, con TCP, se cierra la conexión de datos. */
    end_msg_t end_msg = {
        .code = END_CODE,
        .result = !ok ? END_FAILED : (s_stopped ? END_STOPPED : END_COMPLETED),
        .total = taken,
    };
    if (!send_all(control_sock, &end_msg, sizeof(end_msg))) {
        ESP_LOGW(TAG, "No se pudo enviar END por el canal de control");
    }
    close(data_sock);

    if (s_udp_send_errors > 0) {
        ESP_LOGW(TAG, "%lu datagramas UDP no se pudieron enviar", (unsigned long)s_udp_send_errors);
    }
    const char *result = !ok ? "INTERRUMPIDA" : (s_stopped ? "DETENIDA por el servidor" : "finalizada");
    if (cfg->stop_mode == STOP_BY_COUNT) {
        ESP_LOGI(TAG, "Adquisicion %s: %lu de %lu muestras enviadas (%.2f s)",
                 result,
                 (unsigned long)sent, (unsigned long)cfg->limit, seconds);
    } else {
        ESP_LOGI(TAG, "Adquisicion %s: %lu muestras tomadas, %lu enviadas, en %.2f de %.2f s",
                 result,
                 (unsigned long)taken, (unsigned long)sent, seconds, cfg->limit / 1000.0);
    }
}

/* Atiende una conexión de control: por cada CONFIG que llega responde el ACK
 * y, si es válido, corre la adquisición. Después espera el siguiente CONFIG
 * por la misma conexión, hasta que el servidor la cierre.
 * Devuelve true si hubo al menos una adquisición. */
static bool handle_control(int control_sock, const struct sockaddr_in *server_addr) {
    bool had_session = false;

    while (true) {
        control_config_t cfg;
        if (!recv_config(control_sock, &cfg)) {
            ESP_LOGI(TAG, "El servidor cerro el canal de control");
            return had_session;
        }

        int odr_macro = 0;
        uint8_t ack = validate_config(&cfg, &odr_macro);
        if (!send_all(control_sock, &ack, 1)) {
            ESP_LOGE(TAG, "No se pudo enviar el ACK");
            return had_session;
        }
        if (ack != ACK_OK) {
            ESP_LOGW(TAG, "Configuracion rechazada. ACK=%d", ack);
            continue;               // se espera otro CONFIG
        }

        ESP_LOGI(TAG, "Config OK: range=%d, odr=0x%02x, trans=%d, mode=%d, %s=%lu",
                 cfg.range_g, cfg.odr_code, cfg.transport, cfg.read_mode,
                 cfg.stop_mode == STOP_BY_COUNT ? "samples" : "ms", (unsigned long)cfg.limit);

        if (!apply_sensor_config(&cfg, odr_macro)) {
            return had_session;
        }

        run_acquisition(control_sock, &cfg, odr_macro, server_addr);
        had_session = true;

        if (ONE_SESSION_PER_BOOT) {
            return true;
        }
        ESP_LOGI(TAG, "Esperando la siguiente configuracion...");
    }
}


static i2c_master_bus_handle_t bus_handle = NULL;

void app_main(void) {
    ESP_LOGI(TAG, "=== BMI270 Sistema de Adquisicion Red ===");

    /* 1. Bus I2C con el pinout de la placa. */
    ESP_ERROR_CHECK(i2c_master_init(&bus_handle));
    ESP_LOGI(TAG, "bus I2C listo (SDA=%d SCL=%d)", I2C_MASTER_SDA_IO, I2C_MASTER_SCL_IO);

    /* 2. Sensor. Se inicializa UNA sola vez, con la configuración por defecto;
     *    cada sesión después solo cambia rango y frecuencia (apply_sensor_config).
     *
     *    Tiene que llamarse desde app_main: subir el archivo de configuración
     *    al chip ocupa ~8 KB de stack, y por eso el proyecto fija
     *    CONFIG_ESP_MAIN_TASK_STACK_SIZE=16384 en sdkconfig.defaults. */
    esp_err_t err = bmi270_init(bus_handle, ACC_ODR, ACC_AVG, ACC_RANGE, GYR_ODR, GYR_RANGE);
    if (err != ESP_OK || !is_bmi270_active) {
        ESP_LOGE(TAG, "No se pudo inicializar el BMI270: %s", esp_err_to_name(err));
        ESP_LOGE(TAG, "Revisar: cableado SDA/SCL, alimentación, y que la dirección");
        ESP_LOGE(TAG, "sea 0x%02X (SDO a GND) y no 0x69 (SDO a VDD).", BMI270_SLAVE_ADDR);
        return;
    }

    /* 3. WiFi. */
    if (strcmp(WIFI_SSID, "TU_WIFI") == 0) {
        ESP_LOGE(TAG, "Falta configurar la red: edita main/secrets.h con el nombre y la");
        ESP_LOGE(TAG, "clave de tu WiFi y la IP del computador que corre web_server.py.");
        return;
    }
    wifi_init_sta();

    struct sockaddr_in server_addr;
    memset(&server_addr, 0, sizeof(server_addr));
    server_addr.sin_family = AF_INET;
    server_addr.sin_port = htons(CONTROL_PORT);
    server_addr.sin_addr.s_addr = inet_addr(SERVER_IP);
    if (server_addr.sin_addr.s_addr == IPADDR_NONE) {
        ESP_LOGE(TAG, "SERVER_IP no es una direccion valida: %s", SERVER_IP);
        return;
    }

    /* 4. Sesiones con el servidor. */
    while (1) {
        int control_sock = socket(AF_INET, SOCK_STREAM, 0);
        if (control_sock < 0) {
            ESP_LOGE(TAG, "No se pudo crear el socket de control (errno %d)", errno);
            vTaskDelay(pdMS_TO_TICKS(RECONNECT_DELAY_MS));
            continue;
        }

        ESP_LOGI(TAG, "Conectando al control en %s:%d...", SERVER_IP, CONTROL_PORT);
        if (connect(control_sock, (struct sockaddr *)&server_addr, sizeof(server_addr)) != 0) {
            close(control_sock);
            vTaskDelay(pdMS_TO_TICKS(RECONNECT_DELAY_MS));
            continue;
        }
        ESP_LOGI(TAG, "Conectado al servidor de control!");

        bool had_session = handle_control(control_sock, &server_addr);
        close(control_sock);
        ESP_LOGI(TAG, "Desconectado del servidor de control");

        if (had_session && ONE_SESSION_PER_BOOT) {
            ESP_LOGI(TAG, "Sesion terminada. Presiona RESET para iniciar otra.");
            return;
        }
        vTaskDelay(pdMS_TO_TICKS(RECONNECT_DELAY_MS));
    }
}
